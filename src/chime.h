#ifndef CHIME_H
#define CHIME_H

#include <Arduino.h>
#include "motor.h"

// chime.h 提供“让电机唱歌”的能力：
// 它先定义常用音符频率，再用 ChimePlayer 把多个音符排成非阻塞队列。
// 非阻塞的意思是播放旋律时 loop() 仍能继续处理 Wi-Fi 和网页指令。

// ===========================================================================
//  Pre-defined note frequencies (Hz)
//
//  Usage:
//    chime.add(&motorA, NOTE_C4, 100, 200);   // middle C on motorA
//    chime.add(&motorB, NOTE_E4, 100, 200);   // E above middle C on motorB
//
//  These cover MIDI note numbers 24-95 (C1 through B7).
//  The MIDI converter will quantize to the nearest one.
// ===========================================================================

// Octave 1
#define NOTE_C1  33
#define NOTE_CS1 35  // C#1 / Db1
#define NOTE_D1  37
#define NOTE_DS1 39  // D#1 / Eb1
#define NOTE_E1  41
#define NOTE_F1  44
#define NOTE_FS1 46  // F#1 / Gb1
#define NOTE_G1  49
#define NOTE_GS1 52  // G#1 / Ab1
#define NOTE_A1  55
#define NOTE_AS1 58  // A#1 / Bb1
#define NOTE_B1  62

// Octave 2
#define NOTE_C2  65
#define NOTE_CS2 69  // C#2 / Db2
#define NOTE_D2  73
#define NOTE_DS2 78  // D#2 / Eb2
#define NOTE_E2  82
#define NOTE_F2  87
#define NOTE_FS2 93  // F#2 / Gb2
#define NOTE_G2  98
#define NOTE_GS2 104  // G#2 / Ab2
#define NOTE_A2  110
#define NOTE_AS2 117  // A#2 / Bb2
#define NOTE_B2  123

// Octave 3
#define NOTE_C3  131
#define NOTE_CS3 139  // C#3 / Db3
#define NOTE_D3  147
#define NOTE_DS3 156  // D#3 / Eb3
#define NOTE_E3  165
#define NOTE_F3  175
#define NOTE_FS3 185  // F#3 / Gb3
#define NOTE_G3  196
#define NOTE_GS3 208  // G#3 / Ab3
#define NOTE_A3  220
#define NOTE_AS3 233  // A#3 / Bb3
#define NOTE_B3  247

// Octave 4 (middle)
#define NOTE_C4  262
#define NOTE_CS4 277  // C#4 / Db4
#define NOTE_D4  294
#define NOTE_DS4 311  // D#4 / Eb4
#define NOTE_E4  330
#define NOTE_F4  349
#define NOTE_FS4 370  // F#4 / Gb4
#define NOTE_G4  392
#define NOTE_GS4 415  // G#4 / Ab4
#define NOTE_A4  440
#define NOTE_AS4 466  // A#4 / Bb4
#define NOTE_B4  494

// Octave 5
#define NOTE_C5  523
#define NOTE_CS5 554  // C#5 / Db5
#define NOTE_D5  587
#define NOTE_DS5 622  // D#5 / Eb5
#define NOTE_E5  659
#define NOTE_F5  698
#define NOTE_FS5 740  // F#5 / Gb5
#define NOTE_G5  784
#define NOTE_GS5 831  // G#5 / Ab5
#define NOTE_A5  880
#define NOTE_AS5 932  // A#5 / Bb5
#define NOTE_B5  988

// Octave 6
#define NOTE_C6  1047
#define NOTE_CS6 1109  // C#6 / Db6
#define NOTE_D6  1175
#define NOTE_DS6 1245  // D#6 / Eb6
#define NOTE_E6  1319
#define NOTE_F6  1397
#define NOTE_FS6 1480  // F#6 / Gb6
#define NOTE_G6  1568
#define NOTE_GS6 1661  // G#6 / Ab6
#define NOTE_A6  1760
#define NOTE_AS6 1865  // A#6 / Bb6
#define NOTE_B6  1976

// Octave 7
#define NOTE_C7  2093
#define NOTE_CS7 2217  // C#7 / Db7
#define NOTE_D7  2349
#define NOTE_DS7 2489  // D#7 / Eb7
#define NOTE_E7  2637
#define NOTE_F7  2794
#define NOTE_FS7 2960  // F#7 / Gb7
#define NOTE_G7  3136
#define NOTE_GS7 3322  // G#7 / Ab7
#define NOTE_A7  3520
#define NOTE_AS7 3729  // A#7 / Bb7
#define NOTE_B7  3951

// ===========================================================================
//  ChimePlayer  —  Non-blocking chime / melody sequencer
//
//  Usage — individual notes (one at a time):
//    chime.add(&motorA, NOTE_C4, 100, 200);   // queue: C4 on motorA
//    chime.add(&motorA, NOTE_E4, 100, 200);   // queue: E4 on motorA
//    chime.play();
//
//  Usage — simultaneous notes (both motors at once):
//    chime.startStep();                         // begin a "chord" step
//    chime.addToStep(&motorA, NOTE_C4, 100);    // add note A to this step
//    chime.addToStep(&motorB, NOTE_E4, 100);    // add note B to this step
//    chime.endStep(400);                        // both play for 400 ms
//
//    chime.startStep();
//    chime.addToStep(&motorA, NOTE_G4, 100);
//    chime.endStep(300);
//    chime.play();                              // start the whole sequence
//
//    // Call chime.update() every loop().
// ===========================================================================

struct ChimeNote {
  // 这一拍要驱动哪一个电机。
  Motor* motor;           // which motor to play on
  // 音符频率，单位 Hz。
  int    freq;            // frequency in Hz
  // PWM 占空比，0-255；数值越大声音/力度越明显。
  int    duty;            // duty cycle 0-255
};

struct ChimeStep {
  // 指向这一拍里所有同时播放的音符。
  ChimeNote* notes;
  // 这一拍里有几个音符，例如两个电机同时响就是 2。
  int        noteCount;
  // 这一拍持续多久；同一步里的音符共享同一个时长。
  int        durationMs;     // all notes in this step share the same duration
};

// ===========================================================================
//  PROGMEM song data  —  for songs generated by tools/midi_to_chime.py
//  A track index (0, 1, ...) maps to a Motor* when loading.
// ===========================================================================

struct SongNote {
  // MIDI 转换后使用 track 索引，播放时再映射到 motorA/motorB。
  uint8_t  track;       // 0 = motorA, 1 = motorB, ...
  // 音符频率。
  uint16_t freq;        // frequency in Hz
  // 占空比，来自 MIDI velocity 映射。
  uint8_t  duty;        // duty cycle 0-255
};

// A step embeds its notes directly (no separate PROGMEM array needed).
// MaxNotes defines the maximum simultaneous notes per step.
#define SONG_STEP_MAX_NOTES 8

struct SongStep {
  // 这一步持续时间。
  uint16_t       durationMs;
  // 这一步同时播放的音符数量。
  uint8_t        noteCount;
  // 固定大小数组，避免生成的 song.h 还要再定义许多小数组。
  SongNote       notes[SONG_STEP_MAX_NOTES];   // inlined
};

struct SongData {
  // 歌曲总共有多少步。
  uint16_t        stepCount;
  // 原始或覆盖后的速度信息，主要用于记录。
  uint16_t        tempoBpm;
  // MIDI 中有音符的轨道数量。
  uint8_t         trackCount;
  // 指向 PROGMEM 中的步骤数组。
  const SongStep* steps;     // pointer into PROGMEM
};

class ChimePlayer {
public:
  ChimePlayer()
    : _steps(nullptr), _stepCount(0), _stepCapacity(0),
      _currentStep(-1), _started(false),
      _pendingNotes(nullptr), _pendingCount(0), _pendingCapacity(0) {}

  // --- Single-note convenience (old behaviour) --------------------------
  void add(Motor* motor, int freq, int duty, int durationMs) {
    // 单音是“一步里只有一个音符”的简写。
    startStep();
    addToStep(motor, freq, duty);
    endStep(durationMs);
  }

  // --- Multi-note step building -----------------------------------------
  void startStep() {
    // 开始收集一个新的同时播放步骤，清空临时音符数量。
    _pendingCount = 0;
  }

  void addToStep(Motor* motor, int freq, int duty) {
    if (_pendingCount >= _pendingCapacity) {
      // 临时数组不够时扩容：第一次 4 个，之后翻倍。
      int newCap = _pendingCapacity ? _pendingCapacity * 2 : 4;
      ChimeNote* newArr = new ChimeNote[newCap];
      for (int i = 0; i < _pendingCount; i++) newArr[i] = _pendingNotes[i];
      delete[] _pendingNotes;
      _pendingNotes = newArr;
      _pendingCapacity = newCap;
    }
    _pendingNotes[_pendingCount].motor = motor;
    _pendingNotes[_pendingCount].freq  = freq;
    _pendingNotes[_pendingCount].duty  = duty;
    _pendingCount++;
  }

  void endStep(int durationMs) {
    if (_pendingCount == 0) return;

    // Grow step array
    if (_stepCount >= _stepCapacity) {
      // 步骤数组不够时同样扩容。
      int newCap = _stepCapacity ? _stepCapacity * 2 : 8;
      ChimeStep* newArr = new ChimeStep[newCap];
      for (int i = 0; i < _stepCount; i++) newArr[i] = _steps[i];
      delete[] _steps;
      _steps = newArr;
      _stepCapacity = newCap;
    }

    // Copy pending notes into a persistent array for this step
    // 把临时音符复制到属于这个步骤的独立数组里，避免后续 startStep() 覆盖。
    ChimeNote* stepNotes = new ChimeNote[_pendingCount];
    for (int i = 0; i < _pendingCount; i++) stepNotes[i] = _pendingNotes[i];

    _steps[_stepCount].notes      = stepNotes;
    _steps[_stepCount].noteCount  = _pendingCount;
    _steps[_stepCount].durationMs = durationMs;
    _stepCount++;
  }

  // --- Start playing -----------------------------------------------------
  void play() {
    // 从第 0 步开始播放，真正的持续推进交给 update()。
    _currentStep = 0;
    _started = true;
    _playStep(0);
  }

  // --- Load a PROGMEM song -----------------------------------------------
  //  Pass a SongData generated by tools/midi_to_chime.py and an array of
  //  Motor* pointers where index 0 = first track, 1 = second track, etc.
  //
  //  Example:
  //    Motor* trackMap[] = { &motorA, &motorB };
  //    chime.loadSong(&mySong, trackMap);
  //    chime.play();
  void loadSong(const SongData* song, Motor** trackMap) {
    // Clear any previously loaded or manually built steps
    // 先清空已有手写旋律，再加载 MIDI 转出的歌曲。
    _clear();

    _stepCount   = song->stepCount;
    _stepCapacity = song->stepCount;
    _steps = new ChimeStep[_stepCount];

    for (uint16_t s = 0; s < _stepCount; s++) {
      // 从 song->steps 逐步复制到 RAM 里的 ChimeStep，方便运行时访问。
      const SongStep& songStep = song->steps[s];

      _steps[s].durationMs = songStep.durationMs;
      _steps[s].noteCount  = songStep.noteCount;
      _steps[s].notes      = new ChimeNote[_steps[s].noteCount];

      for (uint8_t n = 0; n < _steps[s].noteCount; n++) {
        // 把歌曲中的 track 编号转换为真正的 Motor*。
        const SongNote& songNote = songStep.notes[n];

        uint8_t t = songNote.track;
        _steps[s].notes[n].motor = (t < song->trackCount) ? trackMap[t] : trackMap[0];
        _steps[s].notes[n].freq  = songNote.freq;
        _steps[s].notes[n].duty  = songNote.duty;
      }
    }
  }

  // --- Call every loop() — advances to next step when current expires ----
  void update() {
    // 没开始播放或当前步骤无效时，直接返回。
    if (!_started || _currentStep < 0 || _currentStep >= _stepCount) return;

    // Check if ALL motors in this step have finished their notes
    ChimeStep& step = _steps[_currentStep];
    bool allDone = true;
    for (int i = 0; i < step.noteCount; i++) {
      // 每个电机自己判断音符是否到期。
      Motor* m = step.notes[i].motor;
      m->update();
      if (m->isPlaying()) allDone = false;
    }

    if (allDone) {
      // 当前步骤所有音符都结束后，切到下一步。
      _currentStep++;
      if (_currentStep < _stepCount) {
        _playStep(_currentStep);
      } else {
        _started = false;
        _currentStep = -1;
      }
    }
  }

  bool isPlaying() const { return _started; }
  int  stepCount() const { return _stepCount; }
  int  currentStep() const { return _currentStep; }

private:
  ChimeStep* _steps;
  int        _stepCount;
  int        _stepCapacity;
  int        _currentStep;
  bool       _started;

  // Buffer for building one step at a time
  ChimeNote* _pendingNotes;
  int        _pendingCount;
  int        _pendingCapacity;

  void _clear() {
    // 这里目前只重置计数；如果频繁 loadSong，可进一步释放各步骤 notes 以避免内存泄漏。
    _stepCount = 0;
    _stepCapacity = 0;
    _currentStep = -1;
    _started = false;
    _pendingCount = 0;
  }

  void _playStep(int idx) {
    // 播放某一步：同一步里的所有音符几乎同时启动。
    ChimeStep& step = _steps[idx];
    for (int i = 0; i < step.noteCount; i++) {
      ChimeNote& n = step.notes[i];
      n.motor->playNote(n.freq, n.duty, step.durationMs);
    }
  }
};

#endif // CHIME_H
